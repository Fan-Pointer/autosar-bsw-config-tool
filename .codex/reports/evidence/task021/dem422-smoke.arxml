AUTOSAR XML (schema 4.0)
package /Config
  module config Dem: implementation-config-variant=VARIANT-PRE-COMPILE
    DemConfigSet  # This container contains the configuration parameters and sub containers of the Dem module supporting multiple configuration sets.
      DemEventParameter:  # This container contains the configuration (parameters) for events.
        DemEventFailureCycleCounterThreshold = 1
        DemEventId = 1
        DemEventAvailable = false
        DemFFPrestorageSupported = false
        DemEventKind = DEM_EVENT_KIND_BSW
        DemOperationCycleRef = DemOperationCycle
        DemDebounceAlgorithmClass  # Debounce algorithm class: counter based, time based, or monitor internal.
          DemDebounceMonitorInternal  # This container contains the configuration (parameters) for monitor internal debouncing.
    DemGeneral:  # This container contains the configuration (parameters) of the BSW Dem
      DemAvailabilitySupport = DEM_EVENT_AVAILABILITY
      DemClearDTCBehavior = DEM_CLRRESP_NONVOLATILE_FINISH
      DemClearDTCLimitation = DEM_ALL_SUPPORTED_DTCS
      DemDataElementDefaultEndianness = BIG_ENDIAN
      DemEventCombinationSupport = DEM_EVCOMB_DISABLED
      DemEventDisplacementStrategy = DEM_DISPLACEMENT_FULL
      DemEventMemoryEntryStorageTrigger = DEM_TRIGGER_ON_CONFIRMED
      DemOBDSupport = DEM_OBD_DEP_SEC_ECU
      DemOccurrenceCounterProcessing = DEM_PROCESS_OCCCTR_CDTC
      DemStatusBitHandlingTestFailedSinceLastClear = DEM_STATUS_BIT_AGING_AND_DISPLACEMENT
      DemSuppressionSupport = DEM_DTC_SUPPRESSION
      DemTypeOfDTCSupported = DEM_DTC_TRANSLATION_ISO11992_4
      DemTypeOfFreezeFrameRecordNumeration = DEM_FF_RECNUM_CALCULATED
      DemAgingRequieresTestedCycle = false
      DemDebounceCounterBasedSupport = false
      DemDebounceTimeBasedSupport = false
      DemDevErrorDetect = false
      DemGeneralInterfaceSupport = false
      DemOperationCycleStatusStorage = false
      DemPTOSupport = false
      DemResetConfirmedBitOnOverflow = false
      DemStatusBitStorageTestFailed = false
      DemTriggerDcmReports = false
      DemTriggerDltReports = false
      DemTriggerFiMReports = false
      DemTriggerMonitorInitBeforeClearOk = false
      DemVersionInfoApi = false
      DemDtcStatusAvailabilityMask = 1
      DemMaxNumberEventEntryPermanent = 1
      DemMaxNumberPrestoredFF = 1
      DemTaskTime = 0.01
      DemOperationCycle: DemOperationCycleAutomaticEnd=false, DemOperationCycleAutostart=false, DemOperationCycleType=DEM_OPCYC_IGNITION  # This container holds all parameters that are relevant to configure an operation cycle.
      DemPrimaryMemory: DemMaxNumberEventEntryPrimary=1  # This container contains the primary event memory specific parameters of the Dem module.
