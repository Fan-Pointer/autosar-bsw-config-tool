AUTOSAR XML (schema 4.2.2)
package /Config
  module config Interop: implementation-config-variant=VARIANT-PRE-COMPILE
    Root: MemoryDestinationRef=FirstMemory
    FirstMemory
    SecondMemory
